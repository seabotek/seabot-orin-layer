## project/yocto-buildir/conf/bblayers.conf
```bitbake
# Version of layers configuration, specific to
# each defined distro in the repository.

BBPATH = "${TOPDIR}"
BBFILES ?= ""
HOST_USER = "${@os.getenv('USER') or 'ORIN'}"
BBLAYERS_DIR:="${TOPDIR}/.."
BBLAYERS ?= " \
  ${BBLAYERS_DIR}/yocto-layers/poky/meta \
  ${BBLAYERS_DIR}/yocto-layers/meta-tegra \
  ${BBLAYERS_DIR}/yocto-layers/meta-openembedded/meta-oe \
  ${BBLAYERS_DIR}/yocto-layers/meta-openembedded/meta-python \
  ${BBLAYERS_DIR}/yocto-layers/meta-openembedded/meta-networking \
  ${BBLAYERS_DIR}/yocto-layers/meta-openembedded/meta-multimedia \
  ${BBLAYERS_DIR}/yocto-layers/meta-openembedded/meta-filesystems \
  ${BBLAYERS_DIR}/yocto-layers/meta-virtualization \
  ${BBLAYERS_DIR}/yocto-layers/meta-tegra-community \
  ${BBLAYERS_DIR}/yocto-layers/meta-tegra-support \
  ${BBLAYERS_DIR}/yocto-layers/meta-demo-ci \
  ${BBLAYERS_DIR}/yocto-layers/meta-tegrademo \
  ${BBLAYERS_DIR}/yocto-layers/meta-seabot-orin \
  "
```

## project/yocto-layers/meta-seabot-orin/conf/distro/include/optimization.inc
```bitbake
MACHINE_FEATURES:remove = "alsa wifi bluetooth"
DISTRO_FEATURES:remove = "alsa bluetooth debuginfod  wifi x11"
# also we can remove can interface
```

## project/yocto-layers/meta-seabot-orin/conf/distro/include/seabot-base.inc
```bitbake
# this distro is inspired from the tegra-demo distro 
DISTRO = "seabot"
DISTRO_NAME = "Mare Cutos Refrence distro for the seabot robot"
DISTRO_VERSION = "1.0"
# sets a codename to the distro  
DISTRO_CODENAME = "alpha"
# add a vendor suffix to the sdk name 

MAINTAINER = "Moktar SELLAMI <smokthar925@gmail.com>"
#set a target vendor 
TARGET_VENDOR = "-sb"

# setup distro features 
SB_DEFAULT_DISTRO_FEATURES = "multiarch usrmerg systemd pam virtualization "
DISTRO_FEATURES ?= "${DISTRO_FEATURES_DEFAULT} ${SB_DEFAULT_DISTRO_FEATURES}"

# setup machine features 
MACHINE_FEATURES += "usbgadget"
#adding support to systemd 
INIT_MANAGER = "systemd"

# add cve checks for recipes 
# INHERIT += "cve-check" : TODO understand it better and its effects 

# set preferred kernel
PREFERRED_PROVIDER_virtual/kernel = "linux-jammy-nvidia-tegra"

TCLIBCAPPEND = ""

# set package management
PACKAGE_CLASSES = "package_deb"

# inlude other configs, taken from the tegra-demo distro 
require conf/distro/include/no-static-libs.inc
require conf/distro/include/yocto-uninative.inc
require conf/distro/include/security_flags.inc
# isolates he build system from the host system 
INHERIT += "uninative"
```

## project/yocto-layers/meta-seabot-orin/conf/distro/include/seabot-global-conf.inc
```bitbake
require conf/distro/include/host-build-machine-conf.inc
SEABOT_DEB_PACKAGES_REMOTE_SERVER_IP="${MY_SERVER_IP}"
SEABOT_DEB_PACKAGES_REMOTE_SERVER_PORT="${MY_SERVER_PORT}"
```

## project/yocto-layers/meta-seabot-orin/conf/distro/include/seabot-sdk.inc
```bitbake
SDK_VENDOR = "-sbsdk"
# sets the sdk version and removes the meta data from it "1.0+snapshot"
# makes the sdk version shorter 
SDK_VERSION = "${@d.getVar('DISTRO_VERSION').replace('snapshot-${METADATA_REVISION}', 'snapshot')}"
# ensures 
SDK_VERSION[vardepvalue] = "${SDK_VERSION}"
# set sdk name 
SDK_NAME = "${DISTRO}-${TCLIBC}-${SDKMACHINE}-${IMAGE_BASENAME}-${TUNE_PKGARCH}-${MACHINE}"
SDKPATHINSTALL = "/opt/${DISTRO}/${SDK_VERSION}"
```

## project/yocto-layers/meta-seabot-orin/conf/distro/include/seabot-user.inc
```bitbake
# contains the user names and password"

# openssl -5 
# PASS : orin 
SYSTEM_PASSWD  = "\$5\$qPXWPBHBD44Ky/n9\$dV92u8Wmk2vy5WOI017CA/zXSGfKorptWpAkySfuGsA"
SEABOT_USER_UID = "1000"
SEABOT_USER_GID = "1000"
SEABOT_USER_SHELL = "/bin/sh"
SEABOT_USER_NAME = "seabot"
SEABOT_USER_HOMEDIR = "/home/seabot"
SEABOT_USER_PASS = "\$5\$qPXWPBHBD44Ky/n9\$dV92u8Wmk2vy5WOI017CA/zXSGfKorptWpAkySfuGsA"
# Primary group
SEABOT_USER_PGROUP = "seabot"
# Supplementary groups
SEABOT_USER_SGROUPS = "shutdown,users,sudo"
# set up hostname 
hostname:pn-base-files = "seabot-orin-nvme"
```

## project/yocto-layers/meta-seabot-orin/conf/distro/seabot.conf
```bitbake
require include/seabot-base.inc
require include/seabot-user.inc
require include/seabot-sdk.inc
require include/seabot-global-conf.inc
```

## project/yocto-layers/meta-seabot-orin/conf/layer.conf
```bitbake
BBPATH .= ":${LAYERDIR}"
BBFILES += "${LAYERDIR}/recipes-*/*/*.bb ${LAYERDIR}/recipes-*/*/*.bbappend"
BBFILE_COLLECTIONS += "seabot"
BBFILE_PATTERN_seabot = "^${LAYERDIR}/"
BBFILE_PRIORITY_seabot = "6"

# LAYERDEPENDS_seabot = "core"
LAYERSERIES_COMPAT_seabot = "scarthgap"
```

## project/yocto-layers/meta-seabot-orin/conf/machine/seabot-orin-nvme.conf
```bitbake
require conf/machine/p3768-0000-p3767-0004.conf
PARTITION_LAYOUT_EXTERNAL := "flash_l4t_t234_nvme-custom.xml"
```

## yocto-buildir/conf/bblayers.conf
```bitbake
# Version of layers configuration, specific to
# each defined distro in the repository.
# Format: ${DISTRO}-<version>
TD_BBLAYERS_CONF_VERSION = "tegrademo-5"

BBPATH = "${TOPDIR}"
BBFILES ?= ""

BBLAYERS ?= " \
  /home/ORIN/poky/meta \
  /home/ORIN/poky/meta-tegra \
  /home/ORIN/poky/meta-openembedded/meta-oe \
  /home/ORIN/poky/meta-openembedded/meta-python \
  /home/ORIN/poky/meta-openembedded/meta-networking \
  /home/ORIN/poky/meta-openembedded/meta-filesystems \
  /home/ORIN/poky/meta-virtualization \
  /home/ORIN/poky/meta-tegra-community \
  /home/ORIN/poky/meta-tegra-support \
  /home/ORIN/poky/meta-demo-ci \
  /home/ORIN/poky/meta-tegrademo \
  "
```

## yocto-layers/meta-seabot-orin/conf/layer.conf
```bitbake
BBPATH .= ":${LAYERDIR}"
BBFILES += "${LAYERDIR}/recipes-*/*/*.bb ${LAYERDIR}/recipes-*/*/*.bbappend"
BBFILE_COLLECTIONS += "meta-seabot-orin"
BBFILE_PATTERN_meta-seabot-orin = "^${LAYERDIR}/"
BBFILE_PRIORITY_meta-seabot-orin = "6"
LAYERDEPENDS_meta-seabot-orin = "core"
LAYERSERIES_COMPAT_meta-seabot-orin = "scarthgap"
```
